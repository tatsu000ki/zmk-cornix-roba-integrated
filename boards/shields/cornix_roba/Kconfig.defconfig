## boards/shields/cornix_roba/Kconfig.defconfig
```kconfig
if SHIELD_CORNIX_ROBA_L

config ZMK_KEYBOARD_NAME
    default "Cornix-roBa"

config ZMK_SPLIT_ROLE_CENTRAL
    default y

endif

if SHIELD_CORNIX_ROBA_L || SHIELD_CORNIX_ROBA_R

config ZMK_SPLIT
    default y

endif
```

## boards/shields/cornix_roba/Kconfig.shield
```kconfig
config SHIELD_CORNIX_ROBA_L
    def_bool $(shields_list_contains,cornix_roba_L)

config SHIELD_CORNIX_ROBA_R
    def_bool $(shields_list_contains,cornix_roba_R)
```

## config/west.yml
```yaml
manifest:
  remotes:
    - name: zmkfirmware
      url-base: https://github.com/zmkfirmware
    - name: hitsmaxft
      url-base: https://github.com/hitsmaxft
    - name: kumamuk-git
      url-base: https://github.com/kumamuk-git
    - name: urob
      url-base: https://github.com/urob
  projects:
    - name: zmk
      remote: zmkfirmware
      revision: v0.3-branch
      import: app/west.yml
    - name: zmk-keyboard-cornix
      remote: hitsmaxft
      revision: v2.6.8
    - name: zmk-pmw3610-driver
      remote: kumamuk-git
      revision: main
    - name: zmk-helpers
      remote: urob
      revision: main
  self:
    path: config
```
